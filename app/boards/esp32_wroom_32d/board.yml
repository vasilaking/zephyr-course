## app/boards/esp32_wroom_32d/board.yml
```yaml
board:
  name: esp32_wroom_32d
  full_name: ESP32-WROOM-32D
  vendor: espressif
  socs:
  - name: esp32
```

## app/boards/esp32_wroom_32d_scratch/Kconfig
```kconfig
config HEAP_MEM_POOL_ADD_SIZE_BOARD 
    int 
    default 4096 if BOARD_ESP32_WROOM_32D_SCRATCH_ESP32_PROCPU
    default 256 if BOARD_ESP32_WROOM_32D_SCRATCH_ESP32_APPCPU
```

## app/boards/esp32_wroom_32d_scratch/Kconfig.esp32_wroom_32d_scratch
```kconfig
config BOARD_ESP32_WROOM_32D_SCRATCH
	select SOC_ESP32_WROVER_E_N4R8
	select SOC_ESP32_PROCPU if BOARD_ESP32_WROOM_32D_SCRATCH_ESP32_PROCPU
	select SOC_ESP32_APPCPU if BOARD_ESP32_WROOM_32D_SCRATCH_ESP32_APPCPU
```

## app/boards/esp32_wroom_32d_scratch/board.yml
```yaml
board:
  name: esp32_wroom_32d_scratch
  full_name: ESP32-WROOM-32D-SCRATCH
  vendor: espressif
  socs:
  - name: esp32
```
